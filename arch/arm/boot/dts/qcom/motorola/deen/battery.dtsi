/* Copyright (c) 2018, Motorola Mobility Inc. All rights reserved.
 *
 * This program is free software; you can redistribute it and/or modify
 * it under the terms of the GNU General Public License version 2 and
 * only version 2 as published by the Free Software Foundation.
 *
 * This program is distributed in the hope that it will be useful,
 * but WITHOUT ANY WARRANTY; without even the implied warranty of
 * MERCHANTABILITY or FITNESS FOR A PARTICULAR PURPOSE.  See the
 * GNU General Public License for more details.
 */

/{
	/delete-node/ qcom,battery-data;
	mot_batterydata: qcom,battery-data {
		df-serialnum = "SB18C30735";
		#include "batterydata/batterydata-je40-scud.dtsi"
		#include "batterydata/batterydata-je40-atl.dtsi"
	};
};

&pmi8950_charger {
	qcom,stepchg-iterm-ma = <146>;
	qcom,mmi-temp-zones = <0 582 0>,
				<10 1460 582>,
				<15 1460 1460>,
				<45 3000 2000>,
				<60 1460 0>;
};

&pmi8950_fg {
	/delete-property/ qcom,capacity-learning-feedback;
	qcom,thermal-coefficients =  /bits/ 16 <0x2d87 0x9151 0x7d3c>;
};
