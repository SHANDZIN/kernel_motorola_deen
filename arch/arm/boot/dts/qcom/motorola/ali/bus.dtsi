/* Copyright (c) 2018, Motorola Mobility Inc. All rights reserved.
 *
 * This program is free software; you can redistribute it and/or modify
 * it under the terms of the GNU General Public License version 2 and
 * only version 2 as published by the Free Software Foundation.
 *
 * This program is distributed in the hope that it will be useful,
 * but WITHOUT ANY WARRANTY; without even the implied warranty of
 * MERCHANTABILITY or FITNESS FOR A PARTICULAR PURPOSE.  See the
 * GNU General Public License for more details.
 */

&soc {
	/delete-node/ sound-9335;
	/delete-node/ uart@78b0000;
	/delete-node/ uart@7aef000;
	/delete-node/ spi@78b7000;
	/delete-node/ adv_vreg;
	/delete-node/ eldo2;

};

/ {
	aliases {
		spi7 = &spi_7;
	};
};
