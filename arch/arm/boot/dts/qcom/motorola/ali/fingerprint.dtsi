/* Copyright (c) 2018, Motorola Mobility Inc. All rights reserved.
 *
 * This program is free software; you can redistribute it and/or modify
 * it under the terms of the GNU General Public License version 2 and
 * only version 2 as published by the Free Software Foundation.
 *
 * This program is distributed in the hope that it will be useful,
 * but WITHOUT ANY WARRANTY; without even the implied warranty of
 * MERCHANTABILITY or FITNESS FOR A PARTICULAR PURPOSE.  See the
 * GNU General Public License for more details.
 */

&soc {
	fpc_fpc1020 {
		compatible = "fpc,fpc1020";
		status = "ok";
		irq = <&tlmm 48 0>;
		rst = <&tlmm 8 0>;

		pinctrl-names = "default", "suspend";
		pinctrl-0 = <&ldo_en_active &int_active &rst_active>;
		pinctrl-1 = <&ldo_en_suspend &int_suspend &rst_suspend>;
	};
};
