/* Copyright (c) 2018, Motorola Mobility Inc. All rights reserved.
 *
 * This program is free software; you can redistribute it and/or modify
 * it under the terms of the GNU General Public License version 2 and
 * only version 2 as published by the Free Software Foundation.
 *
 * This program is distributed in the hope that it will be useful,
 * but WITHOUT ANY WARRANTY; without even the implied warranty of
 * MERCHANTABILITY or FITNESS FOR A PARTICULAR PURPOSE.  See the
 * GNU General Public License for more details.
 */

&soc {
	i2c_2: i2c@78b6000 { /* BLSP1 QUP2 */
		reg = <0x78b6000 0x1000>;
		pinctrl-names = "i2c_active", "i2c_sleep";
		pinctrl-0 = <&i2c_2_active>;
		pinctrl-1 = <&i2c_2_sleep>;
		/delete-node/ adv7533@39;

		stmvl53l1@29 {
			status = "ok";
			compatible = "st,stmvl53l1";
			reg = <0x29>;
			vdd-vl53l1-supply = <&pm8953_l22>;
			gpios = <&tlmm 66 0>, <&tlmm 129 0>;
			qcom,gpio-reset = <0>;
			qcom,gpio-req-tbl-num = <0 1>;
			qcom,gpio-req-tbl-flags = <0 1>;
			qcom,gpio-req-tbl-label ="TOF_XSHUTDOWN","TOF_INT";
			pinctrl-names = "laser_default", "laser_suspend";
			pinctrl-0 = <&laser_active_irq &laser_active_xsdn>;
			pinctrl-1 = <&laser_suspend_irq &laser_suspend_xsdn>;
			st,sensorthreshold = <60 65>;
			st,xtalkval = <0x1E00 0xFACD 0x0>;
		};

		cypress_capsensor@1D {
			compatible = "cypress,sf3155";
			label = "MotorolaCapSense";
			reg = <0x1D>;
			vdd-supply = <&pm8953_l5>;
			vddio-supply = <&pm8953_l5>;
			avdd-supply = <&pm8953_l5>;
			interrupt-parent = <&tlmm>;
			interrupts = <86 0x2008>;
			silicon_id = <0x0BB11477>;
			block_size = <64>;
			num_of_blocks = <256>;
			secure_bytes = <32>;
			pinctrl-names = "default";
			gpios = <&tlmm 95 0>, /* RESET */
				<&tlmm 59 0>, /* programming SCLK */
				<&tlmm 140 0>, /* programming SDAT */
				<&tlmm 86 0x2008>;
			use-raw-gpio-rw = <1>;
			gpio_base_addr = <0x01000004>;
			gpio_base_size = <0x3d0900>;
			cyttsp,sar-status-reg = <0x50>;
			cyttsp,standby-reg = <0x51>;
			cyttsp,bootloader-addr = <0x02>;
			cyttsp,key-num = <4>;
			cyttsp,key-codes = <4>;
			threshold_reg_array_len = <16>;
			na_threshold_array_val = <0x3A 0x32 0x3B 0x00 0x3C 0x32 0x3D 0x00 0x3E 0x32
				0x3F 0x00 0x40 0x32 0x41 0x00 0x2A 0x90 0x2B 0x01
				0x2C 0x90 0x2D 0x01 0x2E 0x2C 0x2F 0x01 0x30 0x2C 0x31 0x01>;
			latam_threshold_array_val = <0x3A 0x32 0x3B 0x00 0x3C 0x32 0x3D 0x00 0x3E 0x32
				0x3F 0x00 0x40 0x32 0x41 0x00 0x2A 0x90 0x2B 0x01
				0x2C 0x90 0x2D 0x01 0x2E 0x2C 0x2F 0x01 0x30 0x2C 0x31 0x01>;
			emea_threshold_array_val = <0x3A 0x32 0x3B 0x00 0x3C 0x32 0x3D 0x00 0x3E 0x32
				0x3F 0x00 0x40 0x32 0x41 0x00 0x2A 0x90 0x2B 0x01
				0x2C 0x90 0x2D 0x01 0x2E 0x2C 0x2F 0x01 0x30 0x2C 0x31 0x01>;
			prc_threshold_array_val = <0x3A 0x32 0x3B 0x00 0x3C 0x32 0x3D 0x00 0x3E 0x32
				0x3F 0x00 0x40 0x32 0x41 0x00 0x2A 0x90 0x2B 0x01
				0x2C 0x90 0x2D 0x01 0x2E 0x2C 0x2F 0x01 0x30 0x2C 0x31 0x01>;
			apac_threshold_array_val = <0x3A 0x32 0x3B 0x00 0x3C 0x32 0x3D 0x00 0x3E 0x32
				0x3F 0x00 0x40 0x32 0x41 0x00 0x2A 0x90 0x2B 0x01
				0x2C 0x90 0x2D 0x01 0x2E 0x2C 0x2F 0x01 0x30 0x2C 0x31 0x01>;
			brazil_threshold_array_val = <0x3A 0x32 0x3B 0x00 0x3C 0x32 0x3D 0x00 0x3E 0x32
				0x3F 0x00 0x40 0x32 0x41 0x00 0x2A 0x90 0x2B 0x01
				0x2C 0x90 0x2D 0x01 0x2E 0x2C 0x2F 0x01 0x30 0x2C 0x31 0x01>;
			default_threshold_array_val = <0x3A 0x32 0x3B 0x00 0x3C 0x32 0x3D 0x00 0x3E 0x32
				0x3F 0x00 0x40 0x32 0x41 0x00 0x2A 0x90 0x2B 0x01
				0x2C 0x90 0x2D 0x01 0x2E 0x2C 0x2F 0x01 0x30 0x2C 0x31 0x01>;
		};

	};
};
