/* Copyright (c) 2018, Motorola Mobility Inc. All rights reserved.
 *
 * This program is free software; you can redistribute it and/or modify
 * it under the terms of the GNU General Public License version 2 and
 * only version 2 as published by the Free Software Foundation.
 *
 * This program is distributed in the hope that it will be useful,
 * but WITHOUT ANY WARRANTY; without even the implied warranty of
 * MERCHANTABILITY or FITNESS FOR A PARTICULAR PURPOSE.  See the
 * GNU General Public License for more details.
 */

/ {
	/delete-node/ qcom,battery-data;
	mot_batterydata: qcom,battery-data {
		df-serialnum = "SB18C15119";
		#include "batterydata/batterydata-hg30-atl-ali.dtsi"
		#include "batterydata/batterydata-hg30-scud.dtsi"
		#include "batterydata/batterydata-hg30-epcos.dtsi"
	};
};

&pmi8950_charger {
	qcom,eb-batt-psy-name = "gb_battery";
	qcom,eb-pwr-psy-name = "gb_ptp";
	qcom,stepchg-iterm-ma = <170>;
	qcom,mmi-temp-zones = <0 600 0>,
				<15 600 600>,
				<45 3000 2000>,
				<60 1500 0>;
};

&pmi8950_fg {
	qcom,thermal-coefficients =  /bits/ 16 <0xB785 0xB249 0x7135>;
};
