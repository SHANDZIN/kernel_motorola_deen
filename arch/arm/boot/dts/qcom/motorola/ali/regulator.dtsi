/* Copyright (c) 2018, Motorola Mobility Inc. All rights reserved.
 *
 * This program is free software; you can redistribute it and/or modify
 * it under the terms of the GNU General Public License version 2 and
 * only version 2 as published by the Free Software Foundation.
 *
 * This program is distributed in the hope that it will be useful,
 * but WITHOUT ANY WARRANTY; without even the implied warranty of
 * MERCHANTABILITY or FITNESS FOR A PARTICULAR PURPOSE.  See the
 * GNU General Public License for more details.
 */

&pm8953_l22 {
	regulator-min-microvolt = <2850000>;
	regulator-max-microvolt = <2850000>;
	qcom,init-voltage = <2850000>;
	regulator-always-on;
};

&pm8953_gpios {
	gpio@c100 { /* GPIO 2 - USB_5V_EN */
		status = "okay";
		qcom,mode = <1>;		/* Digital Output */
		qcom,output-type = <0>;		/* CMOS logic */
		qcom,pull = <5>;		/* No pull */
		qcom,invert = <0>;		/* Output low initially */
		qcom,vin-sel = <3>;		/* VIN3 */
		qcom,src-sel = <0>;		/* GPIO */
		qcom,out-strength = <2>;	/* Medium */
		qcom,master-en = <1>;		/* Enable GPIO */
	};
};
